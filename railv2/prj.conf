## prj.conf
```kconfig
CONFIG_NEWLIB_LIBC=y
CONFIG_CPLUSPLUS=y
CONFIG_LIB_CPLUSPLUS=y
CONFIG_STD_CPP17=y


CONFIG_EARLY_CONSOLE=y

CONFIG_HEAP_MEM_POOL_SIZE=16384
CONFIG_MAIN_STACK_SIZE=2048

CONFIG_INIT_STACKS=y
CONFIG_THREAD_STACK_INFO=y
CONFIG_SYSTEM_WORKQUEUE_STACK_SIZE=4096
CONFIG_BT_RX_STACK_SIZE=4096

CONFIG_CONSOLE_SUBSYS=y
CONFIG_CONSOLE_GETLINE=y

CONFIG_LOG=y
CONFIG_ASSERT=y

CONFIG_DISPLAY=y
CONFIG_DISPLAY_LOG_LEVEL_ERR=y

CONFIG_I2C=y
# CONFIG_SPI=y

###############################################################################
### lvgl
CONFIG_LVGL=y
CONFIG_LVGL_HOR_RES_MAX=320
CONFIG_LVGL_VER_RES_MAX=240
CONFIG_LVGL_LOG_LEVEL_WRN=y

# Make sure that the rendering task is always executed if we call
# lv_task_handler by setting the refresh period to zero
CONFIG_LVGL_DISP_DEF_REFR_PERIOD=0
# CONFIG_LVGL_COLOR_SCREEN_TRANSP=y
CONFIG_LVGL_ANTIALIAS=y

CONFIG_LVGL_POINTER_KSCAN=y

# CONFIG_LVGL_USE_ANIMATION=y
# CONFIG_LVGL_USE_SHADOW=y
# CONFIG_LVGL_USE_OUTLINE=y
# CONFIG_LVGL_USE_PATTERN=y
# CONFIG_LVGL_USE_VALUE_STR=y
# CONFIG_LVGL_USE_BLEND_MODES=y
# CONFIG_LVGL_USE_OPA_SCALE=y
# CONFIG_LVGL_USE_IMG_TRANSFORM=y
# CONFIG_LVGL_USE_GROUP=y
# CONFIG_LVGL_USE_GPU=y
# CONFIG_LVGL_IMG_CF_INDEXED=y
# CONFIG_LVGL_IMG_CF_ALPHA=y
# CONFIG_LVGL_USE_FILESYSTEM=y
# CONFIG_LVGL_DOUBLE_VDB=y
# CONFIG_LVGL_USE_BIDI=y
# CONFIG_LVGL_USE_ARABIC_PERSIAN_CHARS=y
# CONFIG_LVGL_USE_OBJ_REALIGN=y
CONFIG_LVGL_USE_LABEL=y
# CONFIG_LVGL_LABEL_TEXT_SEL=y
# CONFIG_LVGL_LABEL_LONG_TXT_HINT=y
# CONFIG_LVGL_USE_IMG=y
# CONFIG_LVGL_USE_LINE=y
# CONFIG_LVGL_USE_ARC=y
CONFIG_LVGL_USE_CONT=y
CONFIG_LVGL_USE_PAGE=y
CONFIG_LVGL_USE_WIN=y
CONFIG_LVGL_USE_TABVIEW=y
# CONFIG_LVGL_USE_TILEVIEW=y
# CONFIG_LVGL_USE_CALENDAR=y
# CONFIG_LVGL_CALENDAR_WEEK_STARTS_MONDAY=y
# CONFIG_LVGL_USE_SPINNER=y
# CONFIG_LVGL_USE_CANVAS=y
CONFIG_LVGL_USE_BAR=y
# CONFIG_LVGL_USE_LINEMETER=y
# CONFIG_LVGL_USE_GAUGE=y
# CONFIG_LVGL_USE_CHART=y
# CONFIG_LVGL_USE_TABLE=y
# CONFIG_LVGL_USE_LED=y
# CONFIG_LVGL_USE_MSGBOX=y
# CONFIG_LVGL_USE_TEXTAREA=y
# CONFIG_LVGL_USE_SPINBOX=y
CONFIG_LVGL_USE_BTN=y
# CONFIG_LVGL_USE_IMGBTN=y
# CONFIG_LVGL_IMGBTN_TILED=y
CONFIG_LVGL_USE_BTNMATRIX=y
# CONFIG_LVGL_USE_KEYBOARD=y
CONFIG_LVGL_USE_CHECKBOX=y
# CONFIG_LVGL_USE_LIST=y
CONFIG_LVGL_USE_DROPDOWN=y
CONFIG_LVGL_USE_ROLLER=y
CONFIG_LVGL_USE_SLIDER=y
# CONFIG_LVGL_USE_SWITCH=y
# CONFIG_LVGL_USE_LED=y
# CONFIG_LVGL_USE_OBJMASK=y
CONFIG_LVGL_USE_THEME_MATERIAL=y
# CONFIG_LVGL_FONT_MONTSERRAT_8=y
# CONFIG_LVGL_FONT_MONTSERRAT_10=y
CONFIG_LVGL_FONT_MONTSERRAT_12=y
# CONFIG_LVGL_FONT_MONTSERRAT_14=y
CONFIG_LVGL_FONT_MONTSERRAT_16=y
# CONFIG_LVGL_FONT_MONTSERRAT_18=y
# CONFIG_LVGL_FONT_MONTSERRAT_20=y
# CONFIG_LVGL_FONT_MONTSERRAT_22=y
CONFIG_LVGL_FONT_MONTSERRAT_24=y
# CONFIG_LVGL_FONT_MONTSERRAT_26=y
CONFIG_LVGL_FONT_MONTSERRAT_28=y
# CONFIG_LVGL_FONT_MONTSERRAT_30=y
# CONFIG_LVGL_FONT_MONTSERRAT_32=y
# CONFIG_LVGL_FONT_MONTSERRAT_34=y
# CONFIG_LVGL_FONT_MONTSERRAT_36=y
# CONFIG_LVGL_FONT_MONTSERRAT_38=y
# CONFIG_LVGL_FONT_MONTSERRAT_40=y
# CONFIG_LVGL_FONT_MONTSERRAT_42=y
# CONFIG_LVGL_FONT_MONTSERRAT_44=y
# CONFIG_LVGL_FONT_MONTSERRAT_46=y
# CONFIG_LVGL_FONT_MONTSERRAT_48=y
# CONFIG_LVGL_FONT_MONTSERRAT_12_SUBPX=y
# CONFIG_LVGL_FONT_MONTSERRAT_28_COMPRESSED=y
# CONFIG_LVGL_FONT_DEJAVU_16_PERSIAN_HEBREW=y
# CONFIG_LVGL_FONT_SIMSUN_16_CJK=y
# CONFIG_LVGL_FONT_UNSCII_8=y
# CONFIG_LVGL_USE_FONT_COMPRESSED=y
# CONFIG_LVGL_USE_FONT_SUBPX=y

# CONFIG_LVGL_VDB_SIZE=64
# CONFIG_LVGL_DPI=148
# CONFIG_LVGL_BITS_PER_PIXEL=1
# CONFIG_LVGL_COLOR_DEPTH=LVGL_COLOR_DEPTH_1

###############################################################################
### sensors
CONFIG_SENSOR=y
CONFIG_MPU6050=y
CONFIG_MPU6050_TRIGGER_NONE=y
CONFIG_CBPRINTF_FP_SUPPORT=y

# CONFIG_BMI160=y

###############################################################################
### networking
# CONFIG_NETWORKING=y

# CONFIG_NET_CONFIG_AUTO_INIT=y

# # #CONFIG_NET_TX_STACK_SIZE=2048
# # #CONFIG_NET_RX_STACK_SIZE=2048

# # #CONFIG_NET_PKT_RX_COUNT=10
# # #CONFIG_NET_PKT_TX_COUNT=10
# # #CONFIG_NET_BUF_RX_COUNT=20
# # #CONFIG_NET_BUF_TX_COUNT=20
# # #CONFIG_NET_MAX_CONTEXTS=10


# # CONFIG_NET_IPV4=y
# # CONFIG_NET_IPV6=n

# # CONFIG_NET_TCP=y

# # CONFIG_NET_LOG=y
# # CONFIG_INIT_STACKS=y

# # #CONFIG_NET_STATISTICS=y
# # #CONFIG_NET_STATISTICS_PERIODIC_OUTPUT=n

# CONFIG_WIFI=y
# CONFIG_WIFI_LOG_LEVEL_ERR=y
# # # CONFIG_NET_L2_WIFI_SHELL=y
```

## src/main.cpp
```c
/*
 * Copyright (c) 2018 Google LLC.
 *
 * SPDX-License-Identifier: Apache-2.0
 */

#include <stdbool.h>
#include <stdio.h>
#include <stdlib.h>
#include <string.h>
#include <zephyr.h>
#include <zephyr/types.h>

#include <device.h>
#include <init.h>
#include <kernel.h>
#include <sys/byteorder.h>
#include <sys/crc.h>
#include <sys/printk.h>

#include <console/console.h>

#include <lvgl.h>

#include <drivers/display.h>

#include <logging/log.h>
LOG_MODULE_REGISTER(rail);

#include "Display.h"
#include "Stepper.h"
#include "View.h"

Display get_display() {
  const struct device *display_dev =
      device_get_binding(CONFIG_LVGL_DISPLAY_DEV_NAME);
  __ASSERT(display_dev != NULL, "display device not found.");
  Display display(display_dev);
  return display;
}

Stepper get_stepper() {
  Stepper stepper;
  return stepper;
}

/* size of stack area used by each thread */
#define STACKSIZE 8192
/* scheduling priority used by each thread */
#define PRIORITY 7

K_THREAD_STACK_DEFINE(thread_controller_stack_area, STACKSIZE);
static struct k_thread thread_controller_data;
void thread_controller(void *_controller, void *dummy2, void *dummy3) {
  ARG_UNUSED(dummy2);
  ARG_UNUSED(dummy3);
  Controller *controller = static_cast<Controller *>(_controller);
  while (true) {
    controller->work();
    k_sleep(K_MSEC(0));
  }
}

void start_controller_thread(Controller *controller) {
  k_tid_t my_tid_controller = k_thread_create(
      &thread_controller_data, thread_controller_stack_area,
      K_THREAD_STACK_SIZEOF(thread_controller_stack_area), thread_controller,
      controller, NULL, NULL, PRIORITY, 0, K_NO_WAIT);
  k_thread_name_set(&thread_controller_data, "thread_controller");
  k_thread_start(&thread_controller_data);
}

void main(void) {
  Display display = get_display();
  Stepper stepper = get_stepper();

  Model model(&stepper);
  Controller controller(&model);
  View view(&model, &controller, &display);
  LOG_INF("model = %p", &model);
  LOG_INF("controller = %p", &controller);
  LOG_INF("view = %p", &view);

  start_controller_thread(&controller);
  while (true) {
    lv_task_handler();
    k_sleep(K_MSEC(100));
  }
}
```

## src/Controller.cpp
```c
#include "Controller.h"
#include <logging/log.h>
LOG_MODULE_REGISTER(controller);

K_SEM_DEFINE(_work_in_progress_sem, 1, 1);
Controller::Controller(Model *_model) : model{_model} {
  work_in_progress_sem = &_work_in_progress_sem;
}

void Controller::work() {
  if (k_sem_take(work_in_progress_sem, K_MSEC(50)) != 0) {
    return;
  }
  if (!model->is_in_target_position()) {
    int target_position = model->get_target_position();
    model->get_stepper()->step_towards(target_position);
  }
  if (model->is_stack_in_progress()) {
    do_next_stack_step();
  }
  k_sem_give(work_in_progress_sem);
}

void Controller::go(int dist) { model->go(dist); }
void Controller::go_to(int target_position) {
  model->set_target_position(target_position);
}
void Controller::go_to_upper_bound() {
  model->set_target_position(model->get_upper_bound());
}
void Controller::go_to_lower_bound() {
  model->set_target_position(model->get_lower_bound());
}

void Controller::set_new_upper_bound() {
  model->set_upper_bound(model->get_target_position());
}

void Controller::set_new_lower_bound() {
  model->set_lower_bound(model->get_target_position());
}

void Controller::synchronize_and_sleep(k_timeout_t timeout) {
  k_sleep(K_MSEC(10));

  k_sleep(timeout);
}

void Controller::prepare_stack(int step_number) {
  int start, stop, distance, stack_step_jump;

  int cur_position = model->get_cur_position();
  int upper_bound = model->get_upper_bound();
  int lower_bound = model->get_lower_bound();

  if (abs(lower_bound - cur_position) < abs(upper_bound - cur_position)) {
    start = lower_bound;
    stop = upper_bound;
  } else {
    start = upper_bound;
    stop = lower_bound;
  }

  LOG_INF("prepare_stack: %d -> %d, #=%d\n", start, stop, step_number);

  distance = stop - start;
  stack_step_jump = distance / step_number;
  if (stack_step_jump == 0) {
    LOG_WRN("step_jump of 0\n");
    return;
  }
  int i;
  for (i = 0; i < (step_number - 1); i++) {
    model->set_step_position(i, start + i * stack_step_jump);
  }
  model->set_step_position(step_number - 1, stop);

  model->set_step_number(step_number);

  model->set_stack_in_progress(true);
}

void Controller::stop_stack() {
  LOG_INF("stop_stack\n");
  model->set_step_number(0);
  model->set_stack_in_progress(false);
}

void Controller::do_next_stack_step() {
  if (!model->is_stack_in_progress()) {
    return;
  }

  if (!model->is_in_target_position()) {
    return;
  }

  k_sleep(K_MSEC(2000));

  std::optional<int> nex_position = model->get_next_step_and_increment();
  if (!nex_position.has_value()) {
    return;
  }

  go_to(nex_position.value());
}
```

## src/Controller.h
```c
#ifndef __CONTROLLER_H_
#define __CONTROLLER_H_

#include <device.h>
#include <init.h>
#include <stdbool.h>
#include <stdio.h>
#include <stdlib.h>
#include <string.h>
#include <zephyr.h>
#include <zephyr/types.h>

#include <drivers/display.h>
#include <lvgl.h>

#include <logging/log.h>

#include "Model.h"

class Controller {
  Model *model;
  struct k_sem *work_in_progress_sem;

public:
  Controller(Model *_model);
  void work();

  void go(int dist);
  void go_to(int target_position);
  void go_to_upper_bound();
  void go_to_lower_bound();
  void set_new_upper_bound();
  void set_new_lower_bound();

  void synchronize_and_sleep(k_timeout_t timeout);
  void prepare_stack(int step_number);
  void stop_stack();
  void do_next_stack_step();
};

#endif // __CONTROLLER_H_
```

## src/Display.cpp
```c
#include "Display.h"
#include <logging/log.h>
LOG_MODULE_REGISTER(display);

void Display::init_styles() {
  lv_style_init(&style_normal);
  lv_style_set_text_font(&style_normal, LV_STATE_DEFAULT, font_normal);

  lv_style_init(&style_button);
  lv_style_set_bg_color(&style_button, LV_STATE_DEFAULT, LV_COLOR_GRAY);
  lv_style_set_bg_color(&style_button, LV_STATE_PRESSED, LV_COLOR_RED);
  lv_style_set_radius(&style_button, LV_STATE_DEFAULT, 5);
  lv_style_set_bg_opa(&style_button, LV_STATE_DEFAULT, LV_OPA_COVER);

  lv_style_init(&style_box);
  lv_style_set_bg_color(&style_box, LV_STATE_DEFAULT, LV_COLOR_BLACK);
  lv_style_set_bg_opa(&style_box, LV_STATE_DEFAULT, LV_OPA_COVER);
}

void Display::init_tabview(lv_obj_t *parent) {
  tabview = lv_tabview_create(parent, NULL);
  lv_obj_align(tabview, NULL, LV_ALIGN_IN_BOTTOM_LEFT, 0, 0);
  lv_obj_add_style(tabview, 0, &style_normal);
}

Display::Display(const struct device *display_dev) {
  LOG_INF("initialize display...");
  init_styles();
  init_tabview(lv_scr_act());
  LOG_INF("...initialize display done");
  display_blanking_off(display_dev);
}

lv_obj_t *Display::make_tab(const char *title) {
  return lv_tabview_add_tab(tabview, title);
}

lv_obj_t *Display::add_label(lv_obj_t *parent) {
  lv_obj_t *lbl = lv_label_create(parent, NULL);
  lv_obj_add_style(lbl, 0, &style_normal);
  return lbl;
}

lv_obj_t *Display::add_panel(lv_obj_t *parent) {
  lv_obj_t *panel = lv_obj_create(parent, NULL);
  lv_obj_add_style(panel, 0, &style_box);
  return panel;
}

lv_obj_t *Display::add_button(lv_obj_t *parent, const char *label_text,
                              int width, int heigth) {
  lv_obj_t *btn = lv_btn_create(parent, NULL);
  lv_obj_set_height(btn, heigth);
  lv_obj_set_width(btn, width);
  lv_obj_add_style(btn, 0, &style_button);
  if (label_text != NULL) {
    lv_obj_t *label = lv_label_create(btn, NULL);
    lv_label_set_text(label, label_text);
    lv_obj_add_style(label, 0, &style_normal);
  }
  return btn;
}

lv_obj_t *Display::add_roller(lv_obj_t *parent, const char *options) {
  lv_obj_t *roller = lv_roller_create(parent, NULL);
  lv_roller_set_options(roller, options, LV_ROLLER_MODE_NORMAL);

  lv_roller_set_visible_row_count(roller, 4);
  return roller;
}
```

## src/Display.h
```c
#ifndef __DISPLAY_H_
#define __DISPLAY_H_

#include <drivers/display.h>
#include <lvgl.h>
#include <map>

class Display {
  void init_styles();
  lv_obj_t *header;
  lv_obj_t *tabview;
  void init_header(lv_obj_t *parent);
  void init_tabview(lv_obj_t *parent);

  const lv_font_t *font_title = &lv_font_montserrat_28;
  const lv_font_t *font_subtitle = &lv_font_montserrat_24;
  const lv_font_t *font_normal = &lv_font_montserrat_16;
  const lv_font_t *font_small = &lv_font_montserrat_12;

public:
  Display(const struct device *display_dev);

  lv_style_t style_normal;
  lv_style_t style_button;
  lv_style_t style_box;

  lv_obj_t *get_header();
  lv_obj_t *make_tab(const char *title);
  lv_obj_t *add_label(lv_obj_t *parent);
  lv_obj_t *add_panel(lv_obj_t *parent);
  lv_obj_t *add_button(lv_obj_t *parent, const char *label_text, int width,
                       int heigth);
  lv_obj_t *add_roller(lv_obj_t *parent, const char *options);
};

#endif // __DISPLAY_H_
```

## src/GPIOs.cpp
```c
#include "GPIOs.h"
#include <logging/log.h>
LOG_MODULE_REGISTER(gpios);

GPIO::GPIO(const char *label, int _pin, int flags) {
  LOG_MODULE_DECLARE(gpios);
  pin = _pin;
  dev = device_get_binding(label);
  if (dev != NULL) {
    ret = gpio_pin_configure(dev, pin, GPIO_OUTPUT_ACTIVE | flags);
    if (ret != 0) {
      LOG_ERR("Failed to configure %s pin %i", label, pin);
    }
  } else {
    LOG_ERR("Failed to get device %s", label);
  }
}
void GPIO::set(bool value) {
  LOG_MODULE_DECLARE(gpios);
  if (ret == 0) {
    if (value != cur_value) {
      cur_value = value;

      gpio_pin_set(dev, pin, value);
    }
  } else {
    LOG_WRN("Do nothing, since ret=%i", ret);
  }
}
```

## src/GPIOs.h
```c
#ifndef __GPIOS_H_
#define __GPIOS_H_

#include <device.h>
#include <init.h>
#include <stdbool.h>
#include <stdio.h>
#include <stdlib.h>
#include <string.h>
#include <zephyr.h>
#include <zephyr/types.h>

#include <lvgl.h>

#include <drivers/display.h>
#include <drivers/gpio.h>

class GPIO {
  const struct device *dev;
  int pin = -1;
  int ret = -1;
  bool cur_value = false;

public:
  GPIO(const char *label, int _pin, int flags);
  void set(bool value);
};

class LED : public GPIO {
public:
  LED(const char *label, int _pin, int flags) : GPIO(label, _pin, flags) {
    set(true);
    k_msleep(100);
    set(false);
  };
};

#endif // __GPIOS_H_
```

## src/Model.cpp
```c
#include "Model.h"
#include <logging/log.h>
LOG_MODULE_REGISTER(model);

Model::Model(Stepper *_stepper) { stepper = _stepper; }

void Model::go(int dist) {
  LOG_MODULE_DECLARE(model);
  target_position += dist;
  LOG_INF("target: %i\n", target_position);
}

void Model::set_target_position(int _target_position) {
  target_position = _target_position;
}
int Model::get_target_position() { return target_position; }
void Model::set_upper_bound(int _upper_bound) { upper_bound = _upper_bound; }
int Model::get_upper_bound() { return upper_bound; }
void Model::set_lower_bound(int _lower_bound) { lower_bound = _lower_bound; }
int Model::get_lower_bound() { return lower_bound; }

void Model::set_step_number(int _step_number) {
  step_number = _step_number;
  cur_step_index = 0;
}
void Model::set_step_position(int index, int pos) { stepps[index] = pos; }
std::optional<int> Model::get_next_step_and_increment() {
  if (cur_step_index >= step_number) {
    stack_in_progress = false;
    return {};
  }
  return stepps[cur_step_index++];
}
void Model::set_stack_in_progress(bool _stack_in_progress) {
  stack_in_progress = _stack_in_progress;
}
bool Model::is_stack_in_progress() { return stack_in_progress; }

int Model::get_cur_position() { return stepper->get_position(); }

bool Model::is_in_target_position() {
  return get_cur_position() == get_target_position();
}
```

## src/Model.h
```c
#ifndef __MODEL_H_
#define __MODEL_H_

#include <device.h>
#include <init.h>
#include <stdbool.h>
#include <stdio.h>
#include <stdlib.h>
#include <string.h>
#include <zephyr.h>
#include <zephyr/types.h>

#include <optional>

#include "Stepper.h"

class Model {
  Stepper *stepper;
  int target_position = 0;
  int upper_bound = 0;
  int lower_bound = 0;

  int step_number = 0;
  int cur_step_index = 0;
  int *stepps;
  bool stack_in_progress = false;

public:
  Model(Stepper *_stepper);

  Stepper *get_stepper() {
    return stepper;
    stepps = (int *)malloc(sizeof(int) * 1000);
  };
  void go(int dist);

  void set_target_position(int _target_position);
  int get_target_position();
  void set_upper_bound(int _upper_bound);
  int get_upper_bound();
  void set_lower_bound(int _lower_bound);
  int get_lower_bound();

  void set_step_number(int _step_number);
  int get_step_number() { return step_number; };
  int get_cur_step_index() { return cur_step_index; };
  void set_step_position(int index, int pos);
  std::optional<int> get_next_step_and_increment();
  void set_stack_in_progress(bool _stack_in_progress);
  bool is_stack_in_progress();

  int get_cur_position();
  bool is_in_target_position();
};

#endif // __MODEL_H_
```

## src/Stepper.cpp
```c
#include "Stepper.h"

#include <logging/log.h>
LOG_MODULE_REGISTER(stepper);

K_SEM_DEFINE(_stepper_sem, 1, 1);
Stepper::Stepper() { stepper_sem = &_stepper_sem; }

void Stepper::set_direction_towards(int target) {
  if (target > position) {
    direction = DIR_RIGHT;
    dir.set(true);
  } else {
    direction = DIR_LEFT;
    dir.set(false);
  }
}

bool Stepper::step_towards(int target) {
  if (target == get_position()) {
    return true;
  }
  k_sem_take(stepper_sem, K_FOREVER);
  set_direction_towards(target);
  pulse.pulse();
  position += direction * stepsize;
  k_sem_give(stepper_sem);
  return false;
}

int Stepper::get_position() { return position; }
```

## src/Stepper.h
```c
#ifndef __STEPPER_H_
#define __STEPPER_H_

#include <device.h>
#include <init.h>
#include <stdbool.h>
#include <stdio.h>
#include <stdlib.h>
#include <string.h>
#include <zephyr.h>
#include <zephyr/types.h>

#include <logging/log.h>

#include "GPIOs.h"

#define LED0_NODE DT_ALIAS(led0)
#define LED0_LABEL DT_GPIO_LABEL(LED0_NODE, gpios)
#define LED0_PIN DT_GPIO_PIN(LED0_NODE, gpios)
#define LED0_FLAGS DT_GPIO_FLAGS(LED0_NODE, gpios)
#define LED1_NODE DT_ALIAS(led1)
#define LED1_LABEL DT_GPIO_LABEL(LED1_NODE, gpios)
#define LED1_PIN DT_GPIO_PIN(LED1_NODE, gpios)
#define LED1_FLAGS DT_GPIO_FLAGS(LED1_NODE, gpios)
#define LED2_NODE DT_ALIAS(led2)
#define LED2_LABEL DT_GPIO_LABEL(LED2_NODE, gpios)
#define LED2_PIN DT_GPIO_PIN(LED2_NODE, gpios)
#define LED2_FLAGS DT_GPIO_FLAGS(LED2_NODE, gpios)

#define PULSE_NODE DT_ALIAS(pulse)
#define PULSE_LABEL DT_GPIO_LABEL(PULSE_NODE, gpios)
#define PULSE_PIN DT_GPIO_PIN(PULSE_NODE, gpios)
#define PULSE_FLAGS DT_GPIO_FLAGS(PULSE_NODE, gpios)
#define DIR_NODE DT_ALIAS(dir)
#define DIR_LABEL DT_GPIO_LABEL(DIR_NODE, gpios)
#define DIR_PIN DT_GPIO_PIN(DIR_NODE, gpios)
#define DIR_FLAGS DT_GPIO_FLAGS(DIR_NODE, gpios)

class PULSE : public GPIO {
public:
  PULSE(const char *label, int _pin, int flags) : GPIO(label, _pin, flags){};
  void pulse() {
    LOG_MODULE_DECLARE(stepper);
    set(true);
    k_usleep(10);
    set(false);
    k_usleep(10);
  };
};

#define STEPS_PER_REV 12800
#define DIR_RIGHT 1
#define DIR_LEFT -1

class Stepper {
  struct k_sem *stepper_sem;
  int direction = DIR_RIGHT;
  int stepsize = 1;
  int position = 0;

  LED led0 = LED(LED0_LABEL, LED0_PIN, LED0_FLAGS);
  LED led1 = LED(LED1_LABEL, LED1_PIN, LED1_FLAGS);
  LED led2 = LED(LED2_LABEL, LED2_PIN, LED2_FLAGS);
  PULSE pulse = PULSE(PULSE_LABEL, PULSE_PIN, PULSE_FLAGS);
  GPIO dir = GPIO(DIR_LABEL, DIR_PIN, DIR_FLAGS);

public:
  Stepper();

  void set_direction_towards(int target);
  bool step_towards(int target);

  int get_position();
};

#endif // __STEPPER_H_
```

## src/View.cpp
```c
#include "View.h"
#include <logging/log.h>
LOG_MODULE_REGISTER(view);

#define ACTION_GO_LOWER '<'
#define ACTION_GO_UPPER '>'
#define ACTION_SET_LOWER 'l'
#define ACTION_GO_TO_LOWER 'L'
#define ACTION_SET_UPPER 'u'
#define ACTION_GO_TO_UPPER 'U'
#define ACTION_PREPARE_STACK 's'
#define ACTION_STOP_STACK 'S'

static View *static_view_pointer = NULL;

View::View(Model *_model, Controller *_controller, Display *_display)
    : model{_model}, controller(_controller), display{_display} {
  LOG_MODULE_DECLARE(view);
  static_view_pointer = this;

  pos_label = display->add_label(display->get_header());
  lv_label_set_align(pos_label, LV_LABEL_ALIGN_CENTER);

  lv_obj_t *move_tab = display->make_tab("move");
  fill_move_panel(move_tab);
  lv_obj_t *shoot_tab = display->make_tab("shoot");
  fill_shoot_panel(shoot_tab);

  lv_task_t *task = lv_task_create(
      [](lv_task_t *task) {
        View *view = static_cast<View *>(task->user_data);
        view->update();
      },
      100, LV_TASK_PRIO_MID, this);
};

int View::read_step_size_roller() {
  char str[7] = {0};
  lv_roller_get_selected_str(step_size_roller, str, sizeof(str));
  return atoi(str);
}

int View::read_step_number_roller() {
  char str[12] = {0};
  lv_roller_get_selected_str(step_number_roller, str, sizeof(str));
  int step_number = atoi(str);
  if (step_number < 10) {
    return 10;
  }
  return step_number;
}

void View::event_cb(char action_type, lv_obj_t *obj, lv_event_t event) {
  LOG_MODULE_DECLARE(view);
  char str[12] = {0};

  if (!(event == LV_EVENT_PRESSED || event == LV_EVENT_LONG_PRESSED ||
        event == LV_EVENT_LONG_PRESSED_REPEAT)) {
    return;
  }

  LOG_DBG("event_cb with: %c\n", action_type);

  switch (action_type) {
  case ACTION_PREPARE_STACK: {
    if (!(event == LV_EVENT_PRESSED)) {
      return;
    }
    int step_number = read_step_number_roller();
    LOG_INF("prepare_stack: %d\n", step_number);
    controller->prepare_stack(step_number);
    break;
  }
  case ACTION_STOP_STACK: {
    if (!(event == LV_EVENT_LONG_PRESSED)) {
      return;
    }
    controller->stop_stack();
    break;
  }
  case ACTION_GO_LOWER: {
    int dist = -read_step_size_roller();
    LOG_INF("go: %d\n", dist);
    controller->go(dist);
    break;
  }
  case ACTION_GO_UPPER: {
    int dist = read_step_size_roller();
    LOG_INF("go: %d\n", dist);
    controller->go(dist);
    break;
  }
  case ACTION_SET_LOWER: {
    if (!(event == LV_EVENT_LONG_PRESSED)) {
      return;
    }
    controller->set_new_lower_bound();
    sprintf(str, "%d <-", model->get_lower_bound());
    lv_label_set_text(lower_label, str);
    break;
  }
  case ACTION_GO_TO_LOWER: {
    if (!(event == LV_EVENT_LONG_PRESSED)) {
      return;
    }
    controller->go_to_lower_bound();
    break;
  }
  case ACTION_SET_UPPER: {
    if (!(event == LV_EVENT_LONG_PRESSED)) {
      return;
    }
    controller->set_new_upper_bound();
    sprintf(str, "-> %d", model->get_upper_bound());
    lv_label_set_text(upper_label, str);
    break;
  }
  case ACTION_GO_TO_UPPER: {
    if (!(event == LV_EVENT_LONG_PRESSED)) {
      return;
    }
    controller->go_to_upper_bound();
    break;
  }
  default: {
    LOG_ERR("does not understand action=%c", action_type);
    break;
  }
  }
}

void View::fill_move_panel(lv_obj_t *parent) {
  step_size_roller = display->add_roller(parent, "12800\n"
                                                 "6400\n"
                                                 "1280\n"
                                                 "640\n"
                                                 "128\n"
                                                 "64\n"
                                                 "12\n"
                                                 "6\n"
                                                 "1");
  lv_obj_align(step_size_roller, NULL, LV_ALIGN_IN_TOP_MID, 0, 0);

  lv_obj_t *left_btn = display->add_button(parent, "<<", 100, 60);
  lv_obj_align(left_btn, NULL, LV_ALIGN_IN_TOP_LEFT, 10, 10);
  lv_obj_set_event_cb(left_btn, [](lv_obj_t *btn, lv_event_t event) {
    static_view_pointer->event_cb(ACTION_GO_LOWER, btn, event);
  });
  lv_obj_t *right_btn = display->add_button(parent, ">>", 100, 60);
  lv_obj_align(right_btn, NULL, LV_ALIGN_IN_TOP_RIGHT, -10, 10);
  lv_obj_set_event_cb(right_btn, [](lv_obj_t *btn, lv_event_t event) {
    static_view_pointer->event_cb(ACTION_GO_UPPER, btn, event);
  });

  lv_obj_t *set_lower = display->add_button(parent, "Set lower", 100, 30);
  lv_obj_align(set_lower, NULL, LV_ALIGN_IN_TOP_LEFT, 10, 75);
  lv_obj_set_event_cb(set_lower, [](lv_obj_t *btn, lv_event_t event) {
    static_view_pointer->event_cb(ACTION_SET_LOWER, btn, event);
  });
  lv_obj_t *set_upper = display->add_button(parent, "Set upper", 100, 30);
  lv_obj_align(set_upper, NULL, LV_ALIGN_IN_TOP_RIGHT, -10, 75);
  lv_obj_set_event_cb(set_upper, [](lv_obj_t *btn, lv_event_t event) {
    static_view_pointer->event_cb(ACTION_SET_UPPER, btn, event);
  });

  lv_obj_t *go_to_lower = display->add_button(parent, NULL, 100, 30);
  lower_label = display->add_label(go_to_lower);
  lv_label_set_text(lower_label, "Go to lower");
  lv_obj_align(go_to_lower, NULL, LV_ALIGN_IN_TOP_LEFT, 10, 110);
  lv_obj_set_event_cb(go_to_lower, [](lv_obj_t *btn, lv_event_t event) {
    static_view_pointer->event_cb(ACTION_GO_TO_LOWER, btn, event);
  });

  lv_obj_t *go_to_upper = display->add_button(parent, NULL, 100, 30);
  upper_label = display->add_label(go_to_upper);
  lv_label_set_text(upper_label, "Go to upper");
  lv_obj_align(go_to_upper, NULL, LV_ALIGN_IN_TOP_RIGHT, -10, 110);
  lv_obj_set_event_cb(go_to_upper, [](lv_obj_t *btn, lv_event_t event) {
    static_view_pointer->event_cb(ACTION_GO_TO_UPPER, btn, event);
  });

  // lv_obj_t *slider = lv_slider_create(parent, NULL);
  // lv_obj_align(slider, NULL, LV_ALIGN_IN_BOTTOM_MID, 0, -10);
  // lv_slider_set_range(slider, 0, 100);
  // lv_slider_set_value(slider, 50, 0);
  // // lv_obj_set_width(slider, LV_PCT(95))
}

static const char *shoot_btnm_map[] = {"prepare stack", "\n",   "1step",
                                       "start",         "stop", ""};

static const char *btnm_map[] = {"1",  "2",  "3",       "4",       "5",
                                 "\n", "6",  "7",       "8",       "9",
                                 "0",  "\n", "Action1", "Action2", ""};
void View::fill_shoot_panel(lv_obj_t *parent) {
  step_number_roller = display->add_roller(parent, "10\n"
                                                   "20\n"
                                                   "30\n"
                                                   "50\n"
                                                   "100\n"
                                                   "200\n"
                                                   "300\n"
                                                   "500\n"
                                                   "1000");
  lv_obj_align(step_number_roller, NULL, LV_ALIGN_IN_LEFT_MID, 20, 0);
  lv_roller_set_selected(step_number_roller, 6, LV_ANIM_OFF);

  // lv_obj_t *btnm1 = lv_btnmatrix_create(parent, NULL);
  // lv_btnmatrix_set_map(btnm1, shoot_btnm_map);
  // // lv_btnmatrix_set_btn_width(btnm1, 10, 2);
  // // lv_btnmatrix_set_btn_ctrl(btnm1, 10, LV_BTNMATRIX_CTRL_CHECKABLE);
  // // lv_btnmatrix_set_btn_ctrl(btnm1, 11, LV_BTNMATRIX_CTRL_CHECK_STATE);
  // lv_obj_align(btnm1, NULL, LV_ALIGN_IN_RIGHT_MID, 0, 0);

  lv_obj_t *btnm1 = lv_btnmatrix_create(parent, NULL);
  lv_btnmatrix_set_map(btnm1, btnm_map);
  lv_btnmatrix_set_btn_width(btnm1, 10,
                             2); /*Make "Action1" twice as wide as "Action2"*/
  lv_btnmatrix_set_btn_ctrl(btnm1, 10, LV_BTNMATRIX_CTRL_CHECKABLE);
  lv_btnmatrix_set_btn_ctrl(btnm1, 11, LV_BTNMATRIX_CTRL_CHECK_STATE);
  lv_obj_align(btnm1, NULL, LV_ALIGN_IN_RIGHT_MID, 0, 0);

  // lv_obj_t *stack_button = display->add_button(parent, "stack", 100, 100);
  // lv_obj_align(stack_button, NULL, LV_ALIGN_CENTER, 0, 0);
  // lv_obj_set_event_cb(stack_button, [](lv_obj_t *btn, lv_event_t event) {
  //   static_view_pointer->event_cb(ACTION_PREPARE_STACK, btn, event);
  // });
  // lv_obj_t *autostart_cb = lv_checkbox_create(parent, NULL);
  // lv_checkbox_set_text(autostart_cb, "autostart");
  // lv_obj_align(autostart_cb, NULL, LV_ALIGN_IN_BOTTOM_MID, 0, 0);
  // lv_checkbox_set_checked(autostart_cb, true);

  // lv_obj_t *a_step_button = display->add_button(parent, "1step", 50, 50);
  // lv_obj_align(a_step_button, NULL, LV_ALIGN_IN_TOP_RIGHT, -20, 20);

  // lv_obj_t *start_button = display->add_button(parent, "start", 50, 50);
  // lv_obj_align(start_button, NULL, LV_ALIGN_IN_RIGHT_MID, -20, 0);

  // lv_obj_t *stop_button = display->add_button(parent, "stop", 50, 50);
  // lv_obj_align(stop_button, NULL, LV_ALIGN_IN_BOTTOM_RIGHT, -20, -20);
  // lv_obj_set_event_cb(stop_button, [](lv_obj_t *btn, lv_event_t event) {
  //   static_view_pointer->event_cb(ACTION_STOP_STACK, btn, event);
  // });
}

void View::update() {
  LOG_MODULE_DECLARE(view);

  if (pos_label == NULL) {
    LOG_WRN("cur_label not yet initialized");
    return;
  }

  char str[40] = {0};
  int cur_position = model->get_cur_position();
  int target_position = model->get_target_position();
  if (cur_position == target_position) {
    sprintf(str, "@%d", cur_position);
  } else {
    if (cur_position < target_position) {
      sprintf(str, "%d > %d", cur_position, target_position);
    } else {
      sprintf(str, "%d < %d", target_position, cur_position);
    }
  }
  if (model->is_stack_in_progress()) {
    char str2[45] = {0};
    strcpy(str2, str);
    sprintf(str, "%s | %d of %d", str2, model->get_cur_step_index(),
            model->get_step_number());
  }
  lv_label_set_text(pos_label, str);
}
```

## src/View.h
```c
#ifndef __VIEW_H_
#define __VIEW_H_

#include <device.h>
#include <init.h>
#include <stdbool.h>
#include <stdio.h>
#include <stdlib.h>
#include <string.h>
#include <zephyr.h>
#include <zephyr/types.h>

#include <drivers/display.h>
#include <lvgl.h>

#include <map>

#include "Controller.h"
#include "Display.h"
#include "Model.h"
#include "Stepper.h"

class View {
private:
  Model *model;
  Controller *controller;

  // Devices
  Display *display;

  // labels
  lv_obj_t *pos_label = NULL;
  lv_obj_t *lower_label = NULL;
  lv_obj_t *upper_label = NULL;

  lv_obj_t *step_size_roller = NULL;
  int read_step_size_roller();
  lv_obj_t *step_number_roller = NULL;
  int read_step_number_roller();

  // init functions
  void fill_move_panel(lv_obj_t *parent);
  void fill_shoot_panel(lv_obj_t *parent);

public:
  View(Model *_model, Controller *_controller, Display *_display);
  void event_cb(char action_type, lv_obj_t *obj, lv_event_t event);

  void update();
};

#endif // __VIEW_H_
```
