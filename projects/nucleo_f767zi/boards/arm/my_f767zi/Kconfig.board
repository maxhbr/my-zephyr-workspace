## projects/nucleo_f767zi/boards/arm/my_f767zi/Kconfig.board
```kconfig
# my STM32F767ZI Nucleo board configuration

# Copyright (c) 2019 Roland Ma
# SPDX-License-Identifier: Apache-2.0

config BOARD_MY_F767ZI
	bool "my Nucleo F767ZI Development Board"
	depends on SOC_STM32F767XX
```

## projects/nucleo_h745zi_q/boards/arm/my_f767zi/Kconfig.defconfig
```kconfig
# my STM32F767ZI board configuration

# Copyright (c) 2019 Roland Ma
# SPDX-License-Identifier: Apache-2.0

if BOARD_MY_F767ZI

config BOARD
	default "my_f767zi"

if NETWORKING

config NET_L2_ETHERNET
	default y

endif # NETWORKING

endif # BOARD_MY_F767ZI
```

## scratchpad/MCUDev_DevEBox_STM32H7XX_M/DevEBox_STM32H7XX_M-out_of_tree_board/boards/arm/mcudev_devebox_stm32h7xx_m/Kconfig.board
```kconfig
# MCUdex DevEBox STM32H7XX_M board configuration

# Copyright (c) 2021 Maximilian Huber
# SPDX-License-Identifier: Apache-2.0

config BOARD_DEVEBOX_STM32H7XX_M
	bool "MCUdex DevEBox STM32H7XX_M Development Board"
	depends on SOC_STM32H750XX
```
